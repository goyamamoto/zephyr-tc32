/*
 * SPDX-License-Identifier: Apache-2.0
 */

/*
 * The TC32's soft-float runtime (arch/tc32/core/softfloat): every operation it
 * provides - float and double addition, subtraction, multiplication, division,
 * comparisons, negation and the conversions between float, double and 32- and
 * 64-bit integers - on special and pseudo-random operands, each result compared
 * bit for bit with the value computed on the host (src/vectors.h, generated by
 * gen_vectors.py). The operands are read through volatile objects so that the
 * compiler cannot fold the operations and every one calls the runtime.
 */

#include <stdint.h>
#include <string.h>
#include <zephyr/ztest.h>

struct f_bin_vec {
	uint32_t a, b, add, sub, mul, div, cmp;
};

struct d_bin_vec {
	uint64_t a, b, add, sub, mul, div;
	uint32_t cmp;
};

struct f_conv_vec {
	uint32_t a, i32, u32;
	uint64_t i64, u64, d;
	uint32_t neg;
};

struct d_conv_vec {
	uint64_t a;
	uint32_t i32, u32;
	uint64_t i64, u64;
	uint32_t f;
	uint64_t neg;
};

struct i_conv_vec {
	uint32_t u;
	uint64_t v;
	uint32_t i2f, ui2f;
	uint64_t i2d, ui2d;
	uint32_t l2f, ul2f;
	uint64_t l2d, ul2d;
};

#include "vectors.h"

/* Mismatches printed per test; all are counted. */
#define REPORT_MAX 8U

static float f_of(uint32_t u)
{
	volatile float v;
	float f;

	memcpy(&f, &u, sizeof(f));
	v = f;
	return v;
}

static uint32_t bits_f(float f)
{
	uint32_t u;

	memcpy(&u, &f, sizeof(u));
	return u;
}

static double d_of(uint64_t u)
{
	volatile double v;
	double d;

	memcpy(&d, &u, sizeof(d));
	v = d;
	return v;
}

static uint64_t bits_d(double d)
{
	uint64_t u;

	memcpy(&u, &d, sizeof(u));
	return u;
}

static void check32(const char *op, unsigned int i, uint32_t got, uint32_t want, uint32_t *bad)
{
	if (got != want) {
		if (*bad < REPORT_MAX) {
			TC_PRINT("%s vector %u: got %08x, expected %08x\n", op, i, got, want);
		}
		(*bad)++;
	}
}

static void check64(const char *op, unsigned int i, uint64_t got, uint64_t want, uint32_t *bad)
{
	if (got != want) {
		if (*bad < REPORT_MAX) {
			TC_PRINT("%s vector %u: got %08x%08x, expected %08x%08x\n", op, i,
				 (uint32_t)(got >> 32), (uint32_t)got, (uint32_t)(want >> 32),
				 (uint32_t)want);
		}
		(*bad)++;
	}
}

static uint32_t cmp_mask_f(float a, float b)
{
	return (uint32_t)(a < b) | (uint32_t)(a <= b) << 1 | (uint32_t)(a == b) << 2 |
	       (uint32_t)(a >= b) << 3 | (uint32_t)(a > b) << 4 |
	       (uint32_t)__builtin_isunordered(a, b) << 5;
}

static uint32_t cmp_mask_d(double a, double b)
{
	return (uint32_t)(a < b) | (uint32_t)(a <= b) << 1 | (uint32_t)(a == b) << 2 |
	       (uint32_t)(a >= b) << 3 | (uint32_t)(a > b) << 4 |
	       (uint32_t)__builtin_isunordered(a, b) << 5;
}

ZTEST(tc32_softfloat, test_float_add_sub)
{
	uint32_t bad = 0U;

	for (unsigned int i = 0U; i < ARRAY_SIZE(f_bin_vecs); i++) {
		const struct f_bin_vec *v = &f_bin_vecs[i];

		check32("fadd", i, bits_f(f_of(v->a) + f_of(v->b)), v->add, &bad);
		check32("fsub", i, bits_f(f_of(v->a) - f_of(v->b)), v->sub, &bad);
	}
	zassert_equal(bad, 0U, "%u mismatches in %u vectors", bad, ARRAY_SIZE(f_bin_vecs));
}

ZTEST(tc32_softfloat, test_float_mul_div)
{
	uint32_t bad = 0U;

	for (unsigned int i = 0U; i < ARRAY_SIZE(f_bin_vecs); i++) {
		const struct f_bin_vec *v = &f_bin_vecs[i];

		check32("fmul", i, bits_f(f_of(v->a) * f_of(v->b)), v->mul, &bad);
		check32("fdiv", i, bits_f(f_of(v->a) / f_of(v->b)), v->div, &bad);
	}
	zassert_equal(bad, 0U, "%u mismatches in %u vectors", bad, ARRAY_SIZE(f_bin_vecs));
}

ZTEST(tc32_softfloat, test_float_compare)
{
	uint32_t bad = 0U;

	for (unsigned int i = 0U; i < ARRAY_SIZE(f_bin_vecs); i++) {
		const struct f_bin_vec *v = &f_bin_vecs[i];

		check32("fcmp", i, cmp_mask_f(f_of(v->a), f_of(v->b)), v->cmp, &bad);
	}
	zassert_equal(bad, 0U, "%u mismatches in %u vectors", bad, ARRAY_SIZE(f_bin_vecs));
}

ZTEST(tc32_softfloat, test_double_add_sub)
{
	uint32_t bad = 0U;

	for (unsigned int i = 0U; i < ARRAY_SIZE(d_bin_vecs); i++) {
		const struct d_bin_vec *v = &d_bin_vecs[i];

		check64("dadd", i, bits_d(d_of(v->a) + d_of(v->b)), v->add, &bad);
		check64("dsub", i, bits_d(d_of(v->a) - d_of(v->b)), v->sub, &bad);
	}
	zassert_equal(bad, 0U, "%u mismatches in %u vectors", bad, ARRAY_SIZE(d_bin_vecs));
}

ZTEST(tc32_softfloat, test_double_mul_div)
{
	uint32_t bad = 0U;

	for (unsigned int i = 0U; i < ARRAY_SIZE(d_bin_vecs); i++) {
		const struct d_bin_vec *v = &d_bin_vecs[i];

		check64("dmul", i, bits_d(d_of(v->a) * d_of(v->b)), v->mul, &bad);
		check64("ddiv", i, bits_d(d_of(v->a) / d_of(v->b)), v->div, &bad);
	}
	zassert_equal(bad, 0U, "%u mismatches in %u vectors", bad, ARRAY_SIZE(d_bin_vecs));
}

ZTEST(tc32_softfloat, test_double_compare)
{
	uint32_t bad = 0U;

	for (unsigned int i = 0U; i < ARRAY_SIZE(d_bin_vecs); i++) {
		const struct d_bin_vec *v = &d_bin_vecs[i];

		check32("dcmp", i, cmp_mask_d(d_of(v->a), d_of(v->b)), v->cmp, &bad);
	}
	zassert_equal(bad, 0U, "%u mismatches in %u vectors", bad, ARRAY_SIZE(d_bin_vecs));
}

ZTEST(tc32_softfloat, test_float_conversions)
{
	uint32_t bad = 0U;

	for (unsigned int i = 0U; i < ARRAY_SIZE(f_conv_vecs); i++) {
		const struct f_conv_vec *v = &f_conv_vecs[i];

		check32("f2iz", i, (uint32_t)(int32_t)f_of(v->a), v->i32, &bad);
		check32("f2uiz", i, (uint32_t)f_of(v->a), v->u32, &bad);
		check64("f2lz", i, (uint64_t)(int64_t)f_of(v->a), v->i64, &bad);
		check64("f2ulz", i, (uint64_t)f_of(v->a), v->u64, &bad);
		check64("f2d", i, bits_d((double)f_of(v->a)), v->d, &bad);
		check32("fneg", i, bits_f(-f_of(v->a)), v->neg, &bad);
	}
	zassert_equal(bad, 0U, "%u mismatches in %u vectors", bad, ARRAY_SIZE(f_conv_vecs));
}

ZTEST(tc32_softfloat, test_double_conversions)
{
	uint32_t bad = 0U;

	for (unsigned int i = 0U; i < ARRAY_SIZE(d_conv_vecs); i++) {
		const struct d_conv_vec *v = &d_conv_vecs[i];

		check32("d2iz", i, (uint32_t)(int32_t)d_of(v->a), v->i32, &bad);
		check32("d2uiz", i, (uint32_t)d_of(v->a), v->u32, &bad);
		check64("d2lz", i, (uint64_t)(int64_t)d_of(v->a), v->i64, &bad);
		check64("d2ulz", i, (uint64_t)d_of(v->a), v->u64, &bad);
		check32("d2f", i, bits_f((float)d_of(v->a)), v->f, &bad);
		check64("dneg", i, bits_d(-d_of(v->a)), v->neg, &bad);
	}
	zassert_equal(bad, 0U, "%u mismatches in %u vectors", bad, ARRAY_SIZE(d_conv_vecs));
}

ZTEST(tc32_softfloat, test_int_conversions)
{
	uint32_t bad = 0U;

	for (unsigned int i = 0U; i < ARRAY_SIZE(i_conv_vecs); i++) {
		const struct i_conv_vec *v = &i_conv_vecs[i];
		volatile uint32_t u = v->u;
		volatile uint64_t w = v->v;

		check32("i2f", i, bits_f((float)(int32_t)u), v->i2f, &bad);
		check32("ui2f", i, bits_f((float)u), v->ui2f, &bad);
		check64("i2d", i, bits_d((double)(int32_t)u), v->i2d, &bad);
		check64("ui2d", i, bits_d((double)u), v->ui2d, &bad);
		check32("l2f", i, bits_f((float)(int64_t)w), v->l2f, &bad);
		check32("ul2f", i, bits_f((float)w), v->ul2f, &bad);
		check64("l2d", i, bits_d((double)(int64_t)w), v->l2d, &bad);
		check64("ul2d", i, bits_d((double)w), v->ul2d, &bad);
	}
	zassert_equal(bad, 0U, "%u mismatches in %u vectors", bad, ARRAY_SIZE(i_conv_vecs));
}

ZTEST_SUITE(tc32_softfloat, NULL, NULL, NULL, NULL, NULL);
