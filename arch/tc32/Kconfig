## arch/tc32/Kconfig
```kconfig
# SPDX-License-Identifier: Apache-2.0

menu "TC32 Options"
	depends on TC32

config ARCH
	string
	default "tc32"

config GEN_ISR_TABLES
	default y

config GEN_IRQ_VECTOR_TABLE
	default n

config GEN_SW_ISR_TABLE
	default y

config TC32_BOOT_MIRROR_SIZE
	hex "TC32 boot mirror SRAM reserve size"
	default 0x4000
	help
	  Size of the low SRAM window reserved for the TLSR boot-ROM flash
	  mirror. Under the current XIP startup flow this window must cover the
	  small reset/IRQ bootstrap prefix and the adjacent low-SRAM instruction
	  cache tag/data scratch area used by the TLSR827x flash execution path
	  before normal RAM placement begins.

config TC32_FAST_DIV64
	bool "64-bit division by 32-bit digits"
	default y
	help
	  The 64-bit divisions of the runtime (__aeabi_uldivmod,
	  __aeabi_ldivmod, __divdi3 and the others in
	  arch/tc32/core/compiler_builtins.c) divide by 32-bit steps: one
	  32-bit division when both operands fit in 32 bits, two or four
	  more for a 32-bit divisor (on the TLSR8278 its hardware divider),
	  and shift-and-subtract over the quotient's bits only for a larger
	  divisor; a call takes tens to a few hundred instructions. Without
	  it they divide bit by bit over all 64 bits of the dividend, a few
	  thousand instructions a call, with less code.
	  The bit-serial division is built either way as
	  __tc32_uldivmod_proven, for code that calls it by name; without
	  this option __aeabi_uldivmod is that function under another name.

config TC32_POP_PC_RETURNS
	bool "Thumb returns with pop {..., pc}"
	help
	  Every C compile gets the Thumb-only target feature noarm
	  (-Xclang -target-feature -Xclang +noarm): the code never returns
	  to ARM state, so a function that saved lr returns with
	  pop {..., pc} instead of pop {...}; pop {rN}; bx rN, a few bytes
	  less per function. A compile unit named with tc32_classic_returns()
	  (arch/tc32/CMakeLists.txt) keeps the bx returns. The configuration
	  stops when a test function compiled with the feature does not return
	  with pop {..., pc} (a clang without the feature ignores it without a
	  message), or compiled with +noarm then -noarm does not return
	  through bx. On the direct path (TC32_DIRECT, -mcpu=tc32) the core
	  has the feature itself; without this option every C compile there
	  gets -noarm, so that both paths give the same code.

choice TC32_ICF
	prompt "Identical code folding in the link"
	default TC32_ICF_NONE
	depends on LLVM_USE_LLD
	help
	  ld.lld's --icf keeps one copy of input sections with the same
	  contents, relocations and flags, and points every reference to the
	  others at it. It folds only sections that the linker script puts in
	  the same output section, so code in .ram_code, .boot_ram_mirror or
	  .tc32_flash_copy never merges with code in flash. Folded symbols share
	  an address, so a symbolizer or an emulator breakpoint on one of them
	  names or stops at both.

config TC32_ICF_NONE
	bool "None"

config TC32_ICF_SAFE
	bool "Safe: sections whose address nothing uses"
	help
	  ld.lld --icf=safe folds code and read-only data only when no object
	  marks a symbol of the section address-significant: clang lists every
	  symbol whose address the code uses other than in a direct call in the
	  object's .llvm_addrsig table, and from an object without that
	  table, the translated assembly sources for example, every symbol it
	  defines or references counts as address-significant.
	  Two functions that code compares through pointers keep different
	  addresses.

config TC32_ICF_ALL
	bool "All: code even when its address is used"
	help
	  ld.lld --icf=all folds identical code sections whether or not their
	  address is used: two different functions can then have the same
	  address, so code that tells handlers, callbacks or API functions
	  apart by comparing pointers can take one for the other. Read-only
	  data keeps the safe rule.

endchoice

endmenu
```

## boards/telink/tlsr8278_generic/Kconfig.defconfig
```kconfig
# SPDX-License-Identifier: Apache-2.0

if BOARD_TLSR8278_GENERIC

# Workaround for not being able to have commas in macro arguments
DT_CHOSEN_Z_CODE_PARTITION := zephyr,code-partition

config FLASH_LOAD_OFFSET
	default $(dt_chosen_reg_addr_hex,$(DT_CHOSEN_Z_CODE_PARTITION)) if USE_DT_CODE_PARTITION

config FLASH_LOAD_SIZE
	default $(dt_chosen_reg_size_hex,$(DT_CHOSEN_Z_CODE_PARTITION)) if USE_DT_CODE_PARTITION

config IMG_BLOCK_BUF_SIZE
	default 256 if MCUBOOT_IMG_MANAGER

endif
```

## boards/telink/tlsr8278_generic/Kconfig.tlsr8278_generic
```kconfig
# SPDX-License-Identifier: Apache-2.0

config BOARD_TLSR8278_GENERIC
	select SOC_TLSR8278
```

## boards/telink/tlsr8278_generic/board.yml
```yaml
# SPDX-License-Identifier: Apache-2.0

board:
  name: tlsr8278_generic
  full_name: TLSR8278 Generic (build-only)
  vendor: telink
  socs:
  - name: tlsr8278
```

## boards/telink/tlsr8278_generic/tlsr8278_generic_defconfig
```kconfig
# SPDX-License-Identifier: Apache-2.0

CONFIG_LLVM_USE_LLD=y
CONFIG_TC32_BOOT_MIRROR_SIZE=0x6000
CONFIG_CONSOLE=y
CONFIG_TC32EMU_CONSOLE=y
CONFIG_TIMEOUT_64BIT=y
```

## drivers/adc/Kconfig.b87
```kconfig
# SPDX-License-Identifier: Apache-2.0

config ADC_TELINK_B87
	bool "Telink TLSR8278 SAR ADC driver"
	default y
	depends on DT_HAS_TELINK_B87_ADC_ENABLED
	select ADC_CONFIGURABLE_INPUTS
	help
	  The SAR ADC's misc channel (DS-TLSR8278 12): inputs PB0-PB7, PC4 and
	  PC5 (input-positive 1-10), single-ended against ground or
	  differential, the 1.2 V reference, gain 1 (the chip's other input
	  scale, 1/8, has no gain value in the ADC API), sampling time 3
	  to 48 ADC clock cycles in steps of 3, resolution 14 (two's
	  complement) or 13 (single-ended, below ground read as 0). Each
	  conversion powers the ADC up and takes its code from the DMA
	  (DFIFO2); the ADC is powered down between conversions. tc32_rng's
	  ADC source takes this driver's lock, so the two never interleave.
```

## drivers/clock_control/Kconfig.b87
```kconfig
# SPDX-License-Identifier: Apache-2.0

config CLOCK_CONTROL_TELINK_B87
	bool "Telink TLSR8278 module clock driver"
	default y
	depends on DT_HAS_TELINK_B87_CLOCK_ENABLED
	help
	  Turns the module clocks of the clock enable registers 0x63-0x65 on
	  and off (DS-TLSR8278 4.3) and gives their rate, the system clock as
	  the clock select registers 0x66 and 0x70 set it (4.2). The SoC
	  setup turns every module clock but the TRNG's on at boot.
```

## drivers/flash/Kconfig.b87
```kconfig
# SPDX-License-Identifier: Apache-2.0

config SOC_FLASH_TELINK_B87
	bool "Telink TLSR8278 internal flash driver"
	default y
	depends on DT_HAS_TELINK_B87_FLASH_CONTROLLER_ENABLED
	select FLASH_HAS_DRIVER_ENABLED
	select FLASH_HAS_PAGE_LAYOUT
	select FLASH_HAS_EXPLICIT_ERASE
	select SOC_TLSR8278_MSPI
	help
	  The internal SPI flash the CPU executes from: read, page program and
	  4 KB sector erase by the flash's commands, each transaction from
	  SRAM with interrupts locked until the flash is idle again (a sector
	  erase keeps them locked for its whole time). Data the caller keeps
	  in the flash is copied to the stack 32 octets at a time.

if SOC_FLASH_TELINK_B87

config SOC_FLASH_TELINK_B87_BUSY_TIMEOUT_MS
	int "Longest wait for a program or erase to finish (ms)"
	default 1000
	range 10 100000
	help
	  The status register is read until its write-in-progress bit clears,
	  for at most this long; the operation then fails with -EIO.

endif # SOC_FLASH_TELINK_B87
```

## drivers/gpio/Kconfig.b87
```kconfig
# SPDX-License-Identifier: Apache-2.0

config GPIO_TELINK_B87
	bool "Telink B87 GPIO driver"
	default y
	depends on DT_HAS_TELINK_B87_GPIO_ENABLED
	help
	  Enable the GPIO driver for Telink B87 (TLSR8278) GPIO ports.
```

## drivers/gpio/Kconfig.tlsr8258
```kconfig
# SPDX-License-Identifier: Apache-2.0

config GPIO_TELINK_TLSR8258
	bool "Telink TLSR8258 GPIO driver"
	default y
	depends on DT_HAS_TELINK_TLSR8258_GPIO_ENABLED
	help
	  Enable the GPIO driver for Telink TLSR8258 GPIO ports.
```

## drivers/hwinfo/Kconfig.b87
```kconfig
# SPDX-License-Identifier: Apache-2.0

config HWINFO_TELINK_B87
	bool "Telink TLSR8278 hwinfo driver"
	default y
	depends on DT_HAS_TELINK_B87_HWINFO_ENABLED
	select HWINFO_HAS_DRIVER
	select SOC_TLSR8278_MSPI
	help
	  The device ID is the 128-bit unique ID of the internal flash, read
	  with the flash's command 0x4b from SRAM with interrupts locked. The
	  reset cause is taken at boot: RESET_WATCHDOG when the watchdog's
	  reset status bit (0x72 bit 0) is set, RESET_LOW_POWER_WAKE when a
	  wakeup status bit of analog register 0x44 is (a wake from deep
	  sleep), RESET_POR when neither is. A reset by software (0x6f bit 5)
	  or by the RESETB pin sets no flag the chip documents, so it reads as
	  RESET_POR as well. hwinfo_clear_reset_cause() clears both flags and
	  the cause taken at boot.
```

## drivers/pinctrl/Kconfig.b87
```kconfig
# SPDX-License-Identifier: Apache-2.0

config PINCTRL_TELINK_B87
	bool "Telink TLSR8278 pin controller driver"
	default y
	depends on DT_HAS_TELINK_B87_PINCTRL_ENABLED
	help
	  Sets a pin's function (DS-TLSR8278 Table 7-1) and turns its GPIO
	  function off, or gives it back to the GPIO function; selects the
	  SPI or the I2C on the pins the two share (Table 7-3); sets its pull
	  resistor and input enable.
```

## drivers/spi/Kconfig.b87
```kconfig
# SPDX-License-Identifier: Apache-2.0

config SPI_TELINK_B87
	bool "Telink TLSR8278 SPI master driver"
	default y
	depends on DT_HAS_TELINK_B87_SPI_ENABLED
	depends on CLOCK_CONTROL
	select PINCTRL
	help
	  The SPI master (DS-TLSR8278 7.4): modes 0-3, 8-bit frames, MSB
	  first, a clock of the system clock / ((divider + 1) * 2). The
	  master sends or receives an octet, not both: a transfer sends its
	  TX frames, then receives the RX frames that come after them; one
	  that would keep what comes in while it sends is refused. The chip
	  select is a GPIO or the master's own (active low). Its module clock
	  comes from the clock control driver (CLOCK_CONTROL, the clk node).
```

## drivers/timer/Kconfig.telink_b87
```kconfig
# Copyright (c) 2024 Telink Semiconductor
# SPDX-License-Identifier: Apache-2.0

config TELINK_B87_TIMER
	bool "Telink B87 system timer"
	depends on SOC_SERIES_TLSR827X
	select TICKLESS_CAPABLE
	default y
	depends on DT_HAS_TELINK_B87_STIMER_ENABLED
```

## drivers/timer/Kconfig.tlsr8258_stimer
```kconfig
# Copyright (c) 2024 Telink Semiconductor
# SPDX-License-Identifier: Apache-2.0

config TLSR8258_STIMER
	bool "TLSR8258 system timer"
	depends on SOC_SERIES_TLSR825X
	select TICKLESS_CAPABLE
	default y
	depends on DT_HAS_TELINK_TLSR8258_STIMER_ENABLED

config TLSR8258_STIMER_DEBUG_HOOK
	bool "Enable TLSR8258 stimer debug hook callback"
	depends on TLSR8258_STIMER
	help
	  Enable calling tlsr8258_stimer_debug_tick() from the system timer ISR.
	  This is intended for debugging and sample instrumentation.
```

## drivers/usb/udc/Kconfig.b87
```kconfig
# SPDX-License-Identifier: Apache-2.0

config UDC_TELINK_B87
	bool "Telink TLSR8278 USB device controller driver"
	default y
	depends on DT_HAS_TELINK_B87_USBD_ENABLED
	help
	  Driver for the full-speed USB device controller of the Telink
	  TLSR8278, for the USB device stack (device_next). The controller
	  answers SET_ADDRESS, SET/GET_INTERFACE, GET_STATUS, SET/CLEAR_FEATURE
	  and SYNCH_FRAME itself; the driver tells the stack of the address
	  state and of the host's remote wakeup setting. Alternate interface
	  settings and the host's CLEAR_FEATURE(ENDPOINT_HALT) do not reach the
	  stack, and there are no isochronous endpoints and no SOF events.

if UDC_TELINK_B87

config UDC_TELINK_B87_IRQ_LINES
	bool "Take the TLSR8278 USB interrupt lines"
	default y
	help
	  Enable the controller's five interrupt lines (EP0 setup, data and
	  status, the data endpoints, bus reset) next to the driver's 1 ms
	  poll. Without this option the driver polls only, and the lines
	  stay masked.

config UDC_TELINK_B87_EXTERNAL_POLL
	bool
	help
	  Selected by a board driver that calls udc_b87_poll()
	  (<zephyr/drivers/usb/udc_b87.h>) every millisecond from its
	  own timer interrupt, so that the kernel's timeout processing does not
	  run every millisecond in the system timer interrupt. The driver's
	  poll timer then runs every UDC_TELINK_B87_FALLBACK_POLL_MS and polls
	  only when the board has not polled since its last expiry: USB keeps
	  working, slower, when the board's timer stops.

config UDC_TELINK_B87_FALLBACK_POLL_MS
	int "Period of the fallback poll with an external poll (ms)"
	default 10
	range 2 20
	depends on UDC_TELINK_B87_EXTERNAL_POLL
	help
	  Each expiry runs the kernel's timeout processing in the system timer
	  interrupt, which can hold the board's timer interrupt back. A longer
	  period costs less and only slows USB when the board's timer has
	  stopped. With the board's timer stopped the longest gap between polls
	  is two periods, and USB 2.0 9.2.6.4 gives a request without data, and
	  a status stage, 50 ms: hence at most 20.

config UDC_TELINK_B87_SLOW_POLL
	bool
	depends on !UDC_TELINK_B87_EXTERNAL_POLL
	help
	  Selected by a board driver that calls udc_b87_slow_poll()
	  (<zephyr/drivers/usb/udc_b87.h>) around a low-power state in
	  which no host uses the bus: the poll timer then runs every
	  UDC_TELINK_B87_SLOW_POLL_MS instead of every millisecond, so that the
	  chip can suspend between its expiries.

config UDC_TELINK_B87_SLOW_POLL_MS
	int "Period of the slow poll (ms)"
	default 10
	range 2 20
	depends on UDC_TELINK_B87_SLOW_POLL
	help
	  With the poll slowed, the longest gap between polls is one period;
	  USB 2.0 9.2.6.4 gives a request without data, and a status stage,
	  50 ms.

config UDC_TELINK_B87_SIM
	bool "Route TLSR8278 USB register accesses to a model"
	depends on ARCH_POSIX
	help
	  For host tests on native_sim: the driver calls tlsr_usb_sim_rd8() and
	  tlsr_usb_sim_wr8(), which the test provides, instead of accessing the
	  registers.

endif # UDC_TELINK_B87
```

## drivers/watchdog/Kconfig.b87
```kconfig
# SPDX-License-Identifier: Apache-2.0

config WDT_TELINK_B87
	bool "Telink TLSR8278 watchdog (Timer2) driver"
	default y
	depends on DT_HAS_TELINK_B87_WATCHDOG_ENABLED
	select HAS_WDT_NO_CALLBACKS
	select HAS_WDT_DISABLE_AT_BOOT
	help
	  Timer2 as watchdog: one timeout of 2^18 system clock cycles times a
	  14-bit capture (about 5.5 ms to 89 s at 48 MHz), no callback, a
	  reset of the chip when it expires. The watchdog stops while the chip
	  is in suspend. With WDT_DISABLE_AT_BOOT the driver stops a watchdog
	  that runs at boot (SOC_TLSR8278_EARLY_WATCHDOG_MS); without it, a
	  running watchdog is left as it is until the application installs
	  its timeout and calls wdt_setup().
```

## dts/bindings/adc/telink,b87-adc.yaml
```yaml
# SPDX-License-Identifier: Apache-2.0

description: |
  TLSR8278 SAR ADC (DS-TLSR8278 12), its misc channel, with the DMA that
  brings its codes to SRAM (DFIFO2, 0xb08-0xb1f). Channels name their
  positive input with zephyr,input-positive: 1-8 PB0-PB7, 9 PC4, 10 PC5;
  a differential channel names its negative input the same way.

compatible: "telink,b87-adc"

include: adc-controller.yaml

properties:
  reg:
    required: true

  "#io-channel-cells":
    const: 1

io-channel-cells:
  - input
```

## dts/bindings/clock/telink,b87-clock.yaml
```yaml
# SPDX-License-Identifier: Apache-2.0

description: |
  TLSR8278 module clocks (DS-TLSR8278 4.3): the clock enable registers
  0x63-0x65 and the system clock select 0x66. A device names its module
  clock with one cell, a TLSR8278_CLK_* number
  (<zephyr/dt-bindings/clock/b87-clock.h>), whose rate is the system
  clock's.

compatible: "telink,b87-clock"

include: [clock-controller.yaml, base.yaml]

properties:
  reg:
    required: true

  "#clock-cells":
    const: 1

clock-cells:
  - id
```
