## dts/bindings/flash_controller/telink,b87-flash-controller.yaml
```yaml
# SPDX-License-Identifier: Apache-2.0

description: |
  TLSR8278 internal flash controller: the SPI to the flash the CPU executes
  from, digital registers 0x80000c (data) and 0x80000d (control), which
  DS-TLSR8278 does not document. Its child is the flash itself
  (soc-nv-flash), with write-block-size 1; the driver erases 4 KB sectors.

compatible: "telink,b87-flash-controller"

include: flash-controller.yaml

properties:
  reg:
    required: true
```

## dts/bindings/gpio/telink,b87-gpio.yaml
```yaml
# SPDX-License-Identifier: Apache-2.0

description: Telink B87 GPIO port

compatible: "telink,b87-gpio"

include: [gpio-controller.yaml, base.yaml]

properties:
  reg:
    required: true

  "#gpio-cells":
    const: 2

  interrupts:
    required: true

  interrupt-parent:
    required: true

gpio-cells:
  - pin
  - flags
```

## dts/bindings/gpio/telink,tlsr8258-gpio.yaml
```yaml
# SPDX-License-Identifier: Apache-2.0

description: Telink TLSR8258 GPIO port

compatible: "telink,tlsr8258-gpio"

include: [gpio-controller.yaml, base.yaml]

properties:
  reg:
    required: true

  "#gpio-cells":
    const: 2

  interrupts:
    required: true

  interrupt-parent:
    required: true

gpio-cells:
  - pin
  - flags
```

## dts/bindings/hwinfo/telink,b87-hwinfo.yaml
```yaml
# SPDX-License-Identifier: Apache-2.0

description: |
  TLSR8278 hardware information: the reset status register 0x72, whose bit 0
  the watchdog sets (DS-TLSR8278 5.1.1, write one to clear), the wakeup
  status of analog register 0x44 (Table 2-6), and the 128-bit unique ID the
  internal flash is preloaded with (2.1.3), read with the flash's command
  0x4b.

compatible: "telink,b87-hwinfo"

include: base.yaml

properties:
  reg:
    required: true
    description: The reset status register.
```

## dts/bindings/interrupt-controller/telink,b87-intc.yaml
```yaml
# SPDX-License-Identifier: Apache-2.0

description: Telink B87 interrupt controller

compatible: "telink,b87-intc"

include: [interrupt-controller.yaml, base.yaml]

properties:
  reg:
    required: true

  "#interrupt-cells":
    const: 1

interrupt-cells:
  - irq
```

## dts/bindings/interrupt-controller/telink,tlsr8258-intc.yaml
```yaml
# SPDX-License-Identifier: Apache-2.0

description: Telink TLSR8258 interrupt controller

compatible: "telink,tlsr8258-intc"

include: [interrupt-controller.yaml, base.yaml]

properties:
  reg:
    required: true

  "#interrupt-cells":
    const: 1

interrupt-cells:
  - irq
```
