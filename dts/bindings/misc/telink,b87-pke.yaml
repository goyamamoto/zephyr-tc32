## dts/bindings/misc/telink,b87-pke.yaml
```yaml
# Copyright (c) 2026 Go Yamamoto
# SPDX-License-Identifier: Apache-2.0

description: |
  TLSR8278 public key engine (DS-TLSR8278 16): elliptic curve point
  multiplication and point checks on 256-bit prime curves. The first reg entry
  is the register block (Table 16-2), the second operand RAM A and the third
  operand RAM B (Table 16-1, the ten 256-bit slots of each). tc32_p256.h
  (SOC_TLSR8278_PKE) drives it for P-256.

compatible: "telink,b87-pke"

include: base.yaml

properties:
  reg:
    required: true
```

## dts/bindings/misc/telink,b87-rbg.yaml
```yaml
# SPDX-License-Identifier: Apache-2.0

description: |
  TLSR8278 random bit generator (DS-TLSR8278 17), the register block. The
  datasheet's Table 17-1 numbers the registers 0x4000-0x4087; the block
  answers at 0x804400-0x804487. Only the tc32_rng generator (TC32_RNG) reads
  it, as one of its entropy sources; it is not an entropy device, so its raw
  output is never handed out as random numbers.

compatible: "telink,b87-rbg"

include: base.yaml

properties:
  reg:
    required: true
```

## dts/bindings/net/wireless/telink,b87-radio.yaml
```yaml
# SPDX-License-Identifier: Apache-2.0

description: |
  Telink TLSR8278 radio: BLE 1M and a private 2M mode, with the RF DMA
  channels 2 (RX) and 3 (TX). The registers are not documented in
  DS-TLSR8278; soc/telink/tlsr/tlsr827x/tlsr_radio.c drives them
  (CONFIG_SOC_TLSR8278_RADIO).

compatible: "telink,b87-radio"

include: base.yaml

properties:
  reg:
    required: true

  interrupts:
    required: true
```

## dts/bindings/pinctrl/telink,b87-pinctrl.yaml
```yaml
# SPDX-License-Identifier: Apache-2.0

description: |
  TLSR8278 pin controller (DS-TLSR8278 7.1): the pins' functions (Table 7-1,
  two bits a pin from 0x5a8), their GPIO function bits, the SPI/I2C selects
  of PA3, PA4, PB6 and PD7 (0x5b6, 0x5b7, Table 7-3), the input enables and
  the pull resistors (analog 0x0e-0x15, Table 7-5).

  Each child node is one pin, named in a device's pinctrl-N property:

    #include <zephyr/dt-bindings/pinctrl/b87-pinctrl.h>

    &pinctrl {
            spi0_ck_pa4: spi0_ck_pa4 {
                    pinmux = <TLSR8278_PA4_SPI_CK>;
            };
            spi0_di_pa3: spi0_di_pa3 {
                    pinmux = <TLSR8278_PA3_SPI_DI>;
                    input-enable;
            };
    };

    &spi0 {
            pinctrl-0 = <&spi0_ck_pa4 &spi0_di_pa3>;
            pinctrl-names = "default";
    };

  bias-pull-up is the 10 kOhm pull-up, bias-pull-down the 100 kOhm
  pull-down; with neither the pin has no pull resistor. Without
  input-enable the pin's input is disabled.

compatible: "telink,b87-pinctrl"

include: base.yaml

properties:
  reg:
    required: true
    description: The function and SPI/I2C select registers (0x5a8-0x5b7).

child-binding:
  description: One pin's function and properties.

  include:
    - name: pincfg-node.yaml
      property-allowlist:
        - bias-disable
        - bias-pull-down
        - bias-pull-up
        - input-enable

  properties:
    pinmux:
      required: true
      type: int
      description: TLSR8278_PINMUX() value, <zephyr/dt-bindings/pinctrl/b87-pinctrl.h>.
```

## dts/bindings/spi/telink,b87-spi.yaml
```yaml
# SPDX-License-Identifier: Apache-2.0

description: |
  TLSR8278 SPI master (DS-TLSR8278 7.4): its registers 0x08-0x0b. The pins
  come from the pin controller (pinctrl-0): CK on PA4 or PD7, DO on PA2 or
  PB7, DI on PA3 or PB6, and the master's own chip select on PD2; clocks
  names its module clock.

compatible: "telink,b87-spi"

include: [spi-controller.yaml, pinctrl-device.yaml]

properties:
  reg:
    required: true

  clocks:
    required: true

  pinctrl-0:
    required: true

  pinctrl-names:
    required: true
```

## dts/bindings/timer/telink,b87-stimer.yaml
```yaml
# SPDX-License-Identifier: Apache-2.0

description: Telink B87 system timer

compatible: "telink,b87-stimer"

include: [base.yaml]

properties:
  reg:
    required: true

  interrupts:
    required: true

  interrupt-parent:
    required: true
```

## dts/bindings/timer/telink,tlsr8258-stimer.yaml
```yaml
# SPDX-License-Identifier: Apache-2.0

description: Telink TLSR8258 system timer

compatible: "telink,tlsr8258-stimer"

include: [base.yaml]

properties:
  reg:
    required: true

  interrupts:
    required: true

  interrupt-parent:
    required: true

  clocks:
    required: true
```

## dts/bindings/usb/telink,b87-usbd.yaml
```yaml
# SPDX-License-Identifier: Apache-2.0

description: |
  Telink TLSR8278 full-speed USB device controller.
  Endpoint 0 is an 8-byte control endpoint; endpoints 1, 2, 3, 4, 7 and 8 are
  IN and 5 and 6 are OUT, with buffers in a shared 256-byte USB RAM.

compatible: "telink,b87-usbd"

include: [usb-ep.yaml]

properties:
  reg:
    required: true

  interrupts:
    required: true

  interrupt-names:
    required: true
    description: ep0-setup, ep0-data, ep0-status, ep-data, reset
```

## dts/bindings/watchdog/telink,b87-watchdog.yaml
```yaml
# SPDX-License-Identifier: Apache-2.0

description: |
  TLSR8278 watchdog: Timer2 as watchdog (DS-TLSR8278 5.1.6). The registers
  are the timers' control word and status octet (0x620-0x623) and Timer2's
  count (0x638-0x63b).

compatible: "telink,b87-watchdog"

include: base.yaml

properties:
  reg:
    required: true
```

## lib/crypto/Kconfig
```kconfig
# SPDX-License-Identifier: Apache-2.0

menuconfig TC32_P256
	bool "P-256 for Bluetooth LE Secure Connections (tc32_p256.h)"
	help
	  tc32_p256.h: a public key from a private key, an ECDH shared secret
	  and the check that a point is on the curve, in the octet order the
	  SMP PDUs use. An operation is started and its result taken by a later
	  call. The implementation is chosen below.

if TC32_P256

choice TC32_P256_IMPL
	prompt "Implementation"
	default TC32_P256_SOFT

config TC32_P256_SOFT
	bool "p256-m (software)"
	help
	  lib/crypto/p256-m: constant-time P-256 in C (TF-PSA-Crypto's
	  p256-m), with tc32_p256_soft.c on top. An operation runs to the end
	  inside the start call; the first poll gives the result.

config TC32_P256_PKE
	bool "The TLSR8278's public key engine"
	depends on SOC_TLSR8278 && DT_HAS_TELINK_B87_PKE_ENABLED
	select SOC_TLSR8278_PKE
	help
	  soc/telink/tlsr/tlsr827x/tlsr_pke.c: the chip's engine runs the
	  operation while the caller polls.

endchoice

endif # TC32_P256
```

## soc/telink/tlsr/tlsr825x/Kconfig
```kconfig
# SPDX-License-Identifier: Apache-2.0

config SOC_SERIES_TLSR825X
	bool
	select TC32
	select HAS_TELINK_DRIVERS
	select HAS_PM
	select ARCH_HAS_RAMFUNC_SUPPORT if XIP
	select SOC_PREP_HOOK
	imply XIP

if SOC_SERIES_TLSR825X

config SOC_TLSR8258
	bool

config SOC_SERIES_TLSR825X_PM
	bool "TLSR825x system PM support"
	default y
	depends on PM

config TLSR8258_PM_RC32K
	bool "Use RC32K PM backend"
	default y
	depends on SOC_SERIES_TLSR825X_PM

config TLSR8258_PM_TIMER_WAKEUP
	bool "Enable 32k timer wakeup in PM"
	default y
	depends on SOC_SERIES_TLSR825X_PM

config TLSR8258_PM_GPIO_WAKEUP
	bool "Enable GPIO wakeup helpers in PM"
	default y
	depends on SOC_SERIES_TLSR825X_PM

config TLSR8258_PM_DEEP_RETENTION
	bool "Enable deep-retention PM API surface"
	default n
	depends on SOC_SERIES_TLSR825X_PM
	help
	  Reserved for tlsr8258_pm_deep_retention_for_ms(). Not implemented
	  yet: unlike suspend/deep-sleep, resuming from a deep sleep with
	  SRAM retention re-enters the reset vector instead of returning from
	  a function call, which needs a warm-resume mechanism this port does
	  not have. tlsr8258_pm_deep_retention_for_ms() always returns
	  -ENOTSUP.

config TLSR8258_PM_SHUTDOWN
	bool "Enable shutdown PM API surface"
	default n
	depends on SOC_SERIES_TLSR825X_PM
	help
	  Reserved for the TLSR8258 Shutdown mode. Not implemented yet:
	  tlsr8258_pm_shutdown_for_ms() always returns -ENOTSUP.

endif # SOC_SERIES_TLSR825X
```

## soc/telink/tlsr/tlsr825x/Kconfig.soc
```kconfig
# SPDX-License-Identifier: Apache-2.0

config SOC_SERIES_TLSR825X
	bool
	select SOC_FAMILY_TELINK_TLSR
	help
	  Telink TLSR825x

config SOC_TLSR8258
	bool
	select SOC_SERIES_TLSR825X
	help
	  Telink TLSR8258

config SOC_SERIES
	default "tlsr825x" if SOC_SERIES_TLSR825X

config SOC
	default "tlsr8258" if SOC_TLSR8258
```

## soc/telink/tlsr/tlsr827x/Kconfig
```kconfig
# SPDX-License-Identifier: Apache-2.0

config SOC_SERIES_TLSR827X
	bool
	select TC32
	select HAS_TELINK_DRIVERS
	select ARCH_HAS_RAMFUNC_SUPPORT if XIP
	imply XIP

if SOC_SERIES_TLSR827X

config SOC_TLSR8278
	bool
	select SOC_EARLY_INIT_HOOK

config SOC_TLSR8278_SUSPEND
	bool "TLSR8278 suspend: tlsr8278_suspend()"
	depends on SOC_TLSR8278
	help
	  tlsr8278_suspend() (tlsr8278_suspend.h): the chip's suspend mode
	  with wake on pads, the digital core (USB) or the 32 kHz timer. RAM
	  and registers are kept and execution goes on after the call; the
	  system timer is restored from the 32 kHz timer. Deep sleep and deep
	  retention (a wake through the boot ROM) are not provided.

config SOC_TLSR8278_DEEP_SLEEP
	bool "TLSR8278 deep sleep: tlsr8278_deep_sleep()"
	depends on SOC_TLSR8278_SUSPEND
	help
	  tlsr8278_deep_sleep() (tlsr8278_suspend.h): deep sleep with the wake
	  sources the caller gives (analog 0x26), no timer wake. The chip wakes
	  through the boot ROM, as from a reset.

config SOC_TLSR8278_IDLE_SUSPEND
	bool "TLSR8278 suspend in the idle thread: tlsr8278_idle_suspend()"
	depends on SOC_TLSR8278_SUSPEND && TICKLESS_KERNEL
	select ARCH_HAS_CUSTOM_CPU_IDLE
	help
	  tlsr8278_idle_suspend() (tlsr8278_suspend.h): while an application
	  allows it, arch_cpu_idle() suspends the chip until just before the
	  next kernel timeout or a pad (between BLE connection events, for
	  example). Not through Zephyr's PM, whose policy runs with interrupts
	  off at every idle entry.

if SOC_TLSR8278_IDLE_SUSPEND

config SOC_TLSR8278_IDLE_SUSPEND_MIN_US
	int "Shortest suspend worth entering, in us"
	default 3000

config SOC_TLSR8278_IDLE_SUSPEND_EARLY_US
	int "How much earlier than the next kernel timeout the suspend ends, in us"
	default 1000

endif

config SOC_TLSR8278_RADIO
	bool "TLSR8278 radio: tlsr_radio.h"
	depends on SOC_TLSR8278 && DT_HAS_TELINK_B87_RADIO_ENABLED
	help
	  tlsr_radio.c: the radio's registers for BLE 1M (advertising and
	  connection events, the TX FIFO, SN and NESN, the RF DMA) and for
	  the private 2M mode, the TX power level and the channels. The radio
	  registers (0x400-0x4ff, 0xc08-0xc2d, 0xf00-0xf2f, 0x1220-0x134f) are
	  not in DS-TLSR8278; the comments give what the code writes, reads
	  or waits for. No interrupt handler: the user connects the RF
	  interrupt (TLSR_RADIO_IRQ). tlsr_analog.h gives the analog register
	  port.

config SOC_TLSR8278_MSPI
	bool
	depends on SOC_TLSR8278
	help
	  Transactions with the internal SPI flash from SRAM
	  (tlsr8278_mspi.h): a read with a command, an address and dummy
	  octets, and a write (program, erase, status) with the wait for its
	  end. Selected by the drivers that talk to the flash itself: the
	  flash driver and the hwinfo driver (the flash's unique ID).

config SOC_TLSR8278_PKE
	bool
	depends on SOC_TLSR8278 && DT_HAS_TELINK_B87_PKE_ENABLED
	help
	  Selected by TC32_P256_PKE. tlsr_pke.c: P-256 point multiplication (a public key from a private
	  key, an ECDH shared secret) and the check that a point is on the
	  curve, on the public key engine (DS-TLSR8278 16), polled: a request
	  starts the engine and a later call takes the result, so a thread can
	  go on with other work meanwhile. The engine's clock runs only while
	  an operation is under way, and its operand RAM is cleared after each
	  one. Coordinates and scalars are 32 little-endian octets, as the
	  Bluetooth SMP PDUs carry them.

config SOC_TLSR8278_PKE_TIMEOUT_MS
	int "Longest wait of tc32_p256_mul() and tc32_p256_verify(), in ms"
	default 2000
	depends on SOC_TLSR8278_PKE
	help
	  The blocking calls give up with -ETIMEDOUT when the engine has not
	  finished after this long; the engine's time per operation is not in
	  the datasheet.

config SOC_TLSR8278_ASM_SETUP
	bool "SoC setup from setup/tlsr8278_setup.S (chip_init, clock_init)"
	depends on SOC_TLSR8278
	default y
	help
	  soc_early_init_hook() runs chip_init(0x43, 0) and clock_init(0x20)
	  from setup/tlsr8278_setup.S, instead of this file's C that repeats their
	  register writes. Their variables are blocks of this image. The wait
	  for analog 0x88 bit 7 has no bound. The early watchdog is armed
	  before it either way.

config SOC_TLSR8278_STARTUP
	bool
	depends on SOC_TLSR8278 && XIP
	default y
	help
	  The vectors and the startup from reset to z_cstart come from
	  setup/tlsr8278_startup.S:
	  the header word 0x0088000d at 0x0c, the loader that brings the rest
	  of the RAM code into SRAM through register 0x608, then flash command
	  0xab, the mode stacks, .bss, the cache tags and base, .data and the
	  call to z_cstart. With SOC_TLSR8278_EARLY_WATCHDOG_MS the entry arms
	  the watchdog first (DS-TLSR8278 5.1.6), so all of it, and everything
	  of this image that follows, runs under the watchdog. .ramfunc must be
	  empty and .bss and .data word aligned (the linker script asserts
	  both).

config SOC_TLSR8278_EARLY_WATCHDOG_MS
	int "TLSR8278 watchdog from the start of the SoC setup (ms, 0 off)"
	depends on SOC_TLSR8278
	default 0
	help
	  Start the Timer2 watchdog with this period in soc_early_init_hook(),
	  before the analog setup, the crystal wait and the clock switch (with
	  SOC_TLSR8278_STARTUP also at the reset entry, before the
	  startup code; soc_early_init_hook() then starts the period again), so a
	  boot that hangs before the code that owns the watchdog later (a boot
	  guard at POST_KERNEL) is reset instead of staying stuck. The period
	  is computed for the 48 MHz system clock the SoC setup sets; nothing
	  feeds the watchdog until the owner takes it over, so it must exceed
	  the boot time to that point.

endif # SOC_SERIES_TLSR827X
```

## soc/telink/tlsr/tlsr827x/Kconfig.soc
```kconfig
# SPDX-License-Identifier: Apache-2.0

config SOC_SERIES_TLSR827X
	bool
	select SOC_FAMILY_TELINK_TLSR
	help
	  Telink TLSR827x (B87 family)

config SOC_TLSR8278
	bool
	select SOC_SERIES_TLSR827X
	help
	  Telink TLSR8278: the TC32 core, 64 KB of SRAM and 1 MB of
	  internal flash (see soc.c and telink_b87_timer.c).

config SOC_SERIES
	default "tlsr827x" if SOC_SERIES_TLSR827X

config SOC
	default "tlsr8278" if SOC_TLSR8278
```

## subsys/logging/backends/Kconfig.tc32emu
```kconfig
# SPDX-License-Identifier: Apache-2.0

config LOG_BACKEND_TC32EMU
	bool "TC32 emulator backend (emulator images only)"
	depends on TC32
	select LOG_BACKEND_SUPPORTS_FORMAT_TIMESTAMP
	default y if TC32EMU_CONSOLE
	help
	  Log messages as bytes written one at a time to address 0x80fff0,
	  where TC32-devtools' emulator (run-boot --console) reads them. The
	  address is not a register of the chip: enable this only for images
	  that run in the emulator, such as test builds. printk and stdout go
	  there through the console driver TC32EMU_CONSOLE.

if LOG_BACKEND_TC32EMU

backend = TC32EMU
backend-str = tc32emu
source "subsys/logging/Kconfig.template.log_format_config"

endif # LOG_BACKEND_TC32EMU
```
