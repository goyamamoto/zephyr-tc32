/*
 * Copyright (c) 2026 Go Yamamoto
 * SPDX-License-Identifier: Apache-2.0
 */

/*
 * tc32_aes128_encrypt(): one AES-128 block encryption (FIPS-197), key and
 * data in the standard orientation (first byte the most significant).
 *
 * TC32_AES128_SOFTWARE: in software, the S-box a table in flash, the round
 * keys computed on the fly (no key schedule kept), 64 bytes of stack.
 *
 * TC32_AES128_HW_BLOCK: on the TLSR8278's AES block (DS-TLSR8278 15.1,
 * 15.4: 0x540 bit 0 selects decrypt (1) or encrypt (0), bit 1 reads 1 while
 * input data is needed, bit 2 reads 1 when the output data is ready;
 * 0x548-0x54b the input and output data, as four little-endian words;
 * 0x550-0x55f the key, standard orientation), with interrupts off
 * (tlsr827x_irq_save()) so that callers in several threads and interrupts
 * can share it.
 */

#include <string.h>

#include <zephyr/crypto/tc32_aes.h>
#include <zephyr/kernel.h>
#include <zephyr/sys/byteorder.h>
#include <zephyr/sys/sys_io.h>
#include <zephyr/sys/util.h>

#if defined(CONFIG_TC32_AES128_SOFTWARE)

static const uint8_t sbox[256] = {
	0x63, 0x7c, 0x77, 0x7b, 0xf2, 0x6b, 0x6f, 0xc5, 0x30, 0x01, 0x67, 0x2b,
	0xfe, 0xd7, 0xab, 0x76, 0xca, 0x82, 0xc9, 0x7d, 0xfa, 0x59, 0x47, 0xf0,
	0xad, 0xd4, 0xa2, 0xaf, 0x9c, 0xa4, 0x72, 0xc0, 0xb7, 0xfd, 0x93, 0x26,
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	0xb0, 0x54, 0xbb, 0x16,
};

/* Multiplication by x in GF(2^8). */
static uint8_t xtime(uint8_t a)
{
	return (uint8_t)((a << 1) ^ (((a & 0x80U) != 0U) ? 0x1bU : 0U));
}

void tc32_aes128_encrypt(const uint8_t key[16], const uint8_t in[16], uint8_t out[16])
{
	uint8_t s[16], k[16], t[16];
	uint8_t rcon = 1U;

	memcpy(k, key, sizeof(k));
	for (int i = 0; i < 16; i++) {
		s[i] = in[i] ^ k[i];
	}
	for (int round = 1; round <= 10; round++) {
		/* The next round key from the last (FIPS-197 5.2). */
		k[0] ^= sbox[k[13]] ^ rcon;
		k[1] ^= sbox[k[14]];
		k[2] ^= sbox[k[15]];
		k[3] ^= sbox[k[12]];
		for (int i = 4; i < 16; i++) {
			k[i] ^= k[i - 4];
		}
		rcon = xtime(rcon);
		/* SubBytes and ShiftRows; the state is column-major. */
		for (int c = 0; c < 4; c++) {
			for (int r = 0; r < 4; r++) {
				t[4 * c + r] = sbox[s[4 * ((c + r) & 3) + r]];
			}
		}
		if (round < 10) {
			/* MixColumns. */
			for (int c = 0; c < 16; c += 4) {
				uint8_t a0 = t[c], a1 = t[c + 1], a2 = t[c + 2], a3 = t[c + 3];
				uint8_t all = a0 ^ a1 ^ a2 ^ a3;

				t[c] ^= all ^ xtime(a0 ^ a1);
				t[c + 1] ^= all ^ xtime(a1 ^ a2);
				t[c + 2] ^= all ^ xtime(a2 ^ a3);
				t[c + 3] ^= all ^ xtime(a3 ^ a0);
			}
		}
		for (int i = 0; i < 16; i++) {
			s[i] = t[i] ^ k[i];
		}
	}
	memcpy(out, s, 16);
}

#elif defined(CONFIG_TC32_AES128_HW_BLOCK)

#define AES_CTRL         0x00800540U
#define AES_DATA         0x00800548U
#define AES_KEY          0x00800550U
#define AES_DECRYPT      BIT(0)
#define AES_NEED_INPUT   BIT(1)
#define AES_OUTPUT_READY BIT(2)
/* The block takes 1000 system clock cycles for 16 bytes (DS-TLSR8278 15.1);
 * each poll takes several, so this bound is far above it.
 */
#define AES_WAIT_TRIES   10000U

void tc32_aes128_encrypt(const uint8_t key[16], const uint8_t in[16], uint8_t out[16])
{
	uint8_t irq = tlsr827x_irq_save();

	sys_write8(sys_read8(AES_CTRL) & (uint8_t)~AES_DECRYPT, AES_CTRL);
	for (int i = 0; i < 16; i++) {
		sys_write8(key[i], AES_KEY + i);
	}
	for (int i = 0; i < 16; i += 4) {
		if ((sys_read8(AES_CTRL) & AES_NEED_INPUT) == 0U) {
			break;
		}
		sys_write32(sys_get_le32(&in[i]), AES_DATA);
	}
	for (uint32_t n = 0U; n < AES_WAIT_TRIES && (sys_read8(AES_CTRL) & AES_OUTPUT_READY) == 0U;
	     n++) {
	}
	for (int i = 0; i < 16; i += 4) {
		sys_put_le32(sys_read32(AES_DATA), &out[i]);
	}
	tlsr827x_irq_restore(irq);
}

#endif
